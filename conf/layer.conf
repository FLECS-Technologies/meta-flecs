## conf/layer.conf
```bitbake
# We have a conf and classes directory, add to BBPATH
BBPATH .= ":${LAYERDIR}"

# We have recipes-* directories, add to BBFILES
BBFILES += "${LAYERDIR}/recipes-*/*/*.bb \
            ${LAYERDIR}/recipes-*/*/*.bbappend"

BBFILE_COLLECTIONS += "meta-flecs"
BBFILE_PATTERN_meta-flecs = "^${LAYERDIR}/"
BBFILE_PRIORITY_meta-flecs = "6"

LAYERDEPENDS_meta-flecs = "core"
LAYERSERIES_COMPAT_meta-flecs = "kirkstone"

PREFERRED_VERSION_cmake = "3.28.3%"
PREFERRED_VERSION_cmake-native = "3.28.3%"

PREFERRED_PROVIDER_pkgconfig = "pkgconf"
PREFERRED_PROVIDER_pkgconfig-native = "pkgconf-native"

# Rust toolchain preferred versions:

RUSTVERSION = "1.75%"

RUST_PANIC_STRATEGY = "abort"

PREFERRED_VERSION_cargo ?= "${RUSTVERSION}"
PREFERRED_VERSION_cargo-native ?= "${RUSTVERSION}"
PREFERRED_VERSION_libstd-rs ?= "${RUSTVERSION}"
PREFERRED_VERSION_rust ?= "${RUSTVERSION}"
PREFERRED_VERSION_rust-cross-${TARGET_ARCH} ?= "${RUSTVERSION}"
PREFERRED_VERSION_rust-llvm ?= "${RUSTVERSION}"
PREFERRED_VERSION_rust-llvm-native ?= "${RUSTVERSION}"
PREFERRED_VERSION_rust-native ?= "${RUSTVERSION}"
```
